## examples/esp-idf-component/sdkconfig.defaults
```kconfig
CONFIG_ESP_MAIN_TASK_AFFINITY_CPU1=y

CONFIG_ESP32_DEFAULT_CPU_FREQ_240=y
CONFIG_ESP_SYSTEM_EVENT_TASK_STACK_SIZE=4096
CONFIG_PTHREAD_TASK_STACK_SIZE_DEFAULT=8192
CONFIG_ESP_TLS_SERVER=y

CONFIG_ESP32_SPIRAM_SUPPORT=y
CONFIG_SPIRAM_IGNORE_NOTFOUND=y
CONFIG_SPIRAM_USE_MALLOC=y
CONFIG_SPIRAM_MALLOC_ALWAYSINTERNAL=4090
CONFIG_SPIRAM_ALLOW_BSS_SEG_EXTERNAL_MEMORY=y

CONFIG_ESP_INT_WDT=y
CONFIG_ESP_TASK_WDT=n
CONFIG_VFS_SUPPORT_SELECT=y

CONFIG_MICRO_RDK_ENABLE_BUILD_LIBRARY=y
CONFIG_MICRO_RDK_TASK_STACK_SIZE=22528
CONFIG_MICRO_RDK_TASK_PINNED_TO_CORE_1=y
CONFIG_MBEDTLS_DEFAULT_MEM_ALLOC=y

CONFIG_PARTITION_TABLE_CUSTOM=y
CONFIG_ESPTOOLPY_FLASHSIZE_8MB=y
```

## examples/sdkconfig.defaults.esp32
```kconfig
# Disabled, because somehow causes issues when compiling for ESP32S2, where it is not supported.
# In theory, this `sdkconfig.defaults` file should not be picked up when ESP32S2 is the target, but it somehow does get picked up
CONFIG_ETH_USE_OPENETH=y
CONFIG_MBEDTLS_HARDWARE_AES=y
CONFIG_MBEDTLS_HARDWARE_SHA=y
CONFIG_ETH_USE_OPENETH=y
CONFIG_MBEDTLS_HARDWARE_AES=y
CONFIG_MBEDTLS_HARDWARE_SHA=y
CONFIG_EXAMPLE_ETH_MDC_GPIO=23
CONFIG_EXAMPLE_ETH_MDIO_GPIO=18
CONFIG_EXAMPLE_ETH_PHY_RST_GPIO=5
CONFIG_EXAMPLE_ETH_PHY_ADDR=1
CONFIG_ETH_ENABLED=y
CONFIG_ETH_USE_ESP32_EMAC=y
CONFIG_ETH_PHY_INTERFACE_RMII=y
CONFIG_ETH_RMII_CLK_INPUT=y
# CONFIG_ETH_RMII_CLK_OUTPUT is not set
CONFIG_ETH_RMII_CLK_IN_GPIO=0
CONFIG_ETH_DMA_BUFFER_SIZE=512
CONFIG_ETH_DMA_RX_BUFFER_NUM=10
CONFIG_ETH_DMA_TX_BUFFER_NUM=10
CONFIG_ESP_MAC_ADDR_UNIVERSE_ETH=y
```

## micro-rdk-ffi/micrordklib-idf-component/Kconfig
```kconfig
menu "Micro RDK configuration"
     config MICRO_RDK_ENABLE_BUILD_LIBRARY
        bool "Enable Micro-RDK library"
        default n
        depends on (ESP_SYSTEM_EVENT_TASK_STACK_SIZE >= 4096) && (PTHREAD_TASK_STACK_SIZE_DEFAULT>=8192) && ESP32_SPIRAM_SUPPORT && (SPIRAM_MALLOC_ALWAYSINTERNAL >= 4090) && MBEDTLS_EXTERNAL_MEM_ALLOC
        select ESP_TLS_SERVER
        select SPIRAM_ALLOW_BSS_SEG_EXTERNAL_MEMORY
        select MBEDTLS_SSL_PROTO_DTLS
        select VFS_SUPPORT_SELECT
        help
	   When enabled a user can access micro-rdk-ffi library

     config MICRO_RDK_TASK_STACK_SIZE
     	depends on MICRO_RDK_ENABLE_BUILD_LIBRARY
        int "Select Micro RDK task stack size"
        default 22528

     choice MICRO_RDK_TASK_CORE_ID
        depends on !FREERTOS_UNICORE && MICRO_RDK_ENABLE_BUILD_LIBRARY
        prompt "MicroRDK Task Core ID"
        default MICRO_RDK_TASK_PINNED_TO_CORE_1
        help
            Pinned Micro RDK task to core 0 or core 1.

        config MICRO_RDK_TASK_PINNED_TO_CORE_0
            bool "Core 0"
        config MICRO_RDK_TASK_PINNED_TO_CORE_1
            bool "Core 1"
     endchoice
endmenu
```

## micro-rdk-server/sdkconfig.defaults
```kconfig
# FreeRTOS/ESPIDF configuration
CONFIG_FREERTOS_HZ=100
CONFIG_ESP_SYSTEM_EVENT_TASK_STACK_SIZE=4096
CONFIG_ESP_INT_WDT=y
CONFIG_ESP_TASK_WDT_INIT=n
CONFIG_VFS_SUPPORT_SELECT=y
CONFIG_PTHREAD_TASK_STACK_SIZE_DEFAULT=8192
CONFIG_PTHREAD_TASK_PRIO_DEFAULT=1

# Network Stack config
CONFIG_LWIP_MAX_SOCKETS=13
CONFIG_LWIP_DEBUG=n

# Main Task (micro-rdk task) configuration
CONFIG_ESP_MAIN_TASK_STACK_SIZE=22528
CONFIG_ESP_MAIN_TASK_AFFINITY_NO_AFFINITY=y
#CONFIG_ESP_MAIN_TASK_AFFINITY_CPU0
#CONFIG_ESP_MAIN_TASK_AFFINITY=0x0


# MbedTLS Config
CONFIG_MBEDTLS_CERTIFICATE_BUNDLE=y
CONFIG_MBEDTLS_CERTIFICATE_BUNDLE_DEFAULT_CMN=y
#CONFIG_MBEDTLS_DEBUG=y
CONFIG_MBEDTLS_SSL_PROTO_DTLS=y
CONFIG_MBEDTLS_DEFAULT_MEM_ALLOC=y
CONFIG_MBEDTLS_TLS_SERVER_AND_CLIENT=y
CONFIG_MBEDTLS_HARDWARE_AES=y
CONFIG_MBEDTLS_HARDWARE_SHA=y

# Wifi Configuration
CONFIG_ESP_WIFI_IRAM_OPT=n
CONFIG_ESP_WIFI_RX_IRAM_OPT=n
CONFIG_ESP_WIFI_TASK_PINNED_TO_CORE_0=y

# Coredump
CONFIG_ESP_COREDUMP_ENABLE_TO_FLASH=y
CONFIG_ESP_COREDUMP_DATA_FORMAT_ELF=y
CONFIG_ESP_COREDUMP_CHECKSUM_SHA256=y
CONFIG_ESP_COREDUMP_ENABLE=y
CONFIG_ESP_COREDUMP_MAX_TASKS_NUM=64
CONFIG_ESP_COREDUMP_DECODE="disable"

# NTP Config
CONFIG_LWIP_SNTP_UPDATE_DELAY=86400000
```

## micro-rdk-server/sdkconfig.defaults.esp32
```kconfig
# Esp32 Specifics
CONFIG_ESP_DEFAULT_CPU_FREQ_MHZ_240=y
CONFIG_ESP_DEFAULT_CPU_FREQ_MHZ=240
CONFIG_ESPTOOLPY_FLASHFREQ_40M=y
CONFIG_ESPTOOLPY_FLASHFREQ="40m"
CONFIG_ESPTOOLPY_FLASHMODE_DIO=y
CONFIG_FREERTOS_UNICORE=n

# SPIRAM configuration
CONFIG_SPIRAM=y
CONFIG_SPIRAM_SPEED_80M=y
CONFIG_SPIRAM_IGNORE_NOTFOUND=y
CONFIG_SPIRAM_USE_MALLOC=y
CONFIG_SPIRAM_MALLOC_ALWAYSINTERNAL=4090
CONFIG_SPIRAM_ALLOW_BSS_SEG_EXTERNAL_MEMORY=y

# Misc
CONFIG_ETH_USE_OPENETH=y
CONFIG_CAMERA_TASK_PINNED_TO_CORE=CAMERA_CORE1
```

## micro-rdk-server/sdkconfig.defaults.esp32c6
```kconfig
# Esp32C6 Specifics
CONFIG_ESP_DEFAULT_CPU_FREQ_MHZ_160=y
CONFIG_ESP_DEFAULT_CPU_FREQ_MHZ=160
CONFIG_ESPTOOLPY_FLASHFREQ_80M=y
CONFIG_ESPTOOLPY_FLASHFREQ="80m"
CONFIG_ESPTOOLPY_FLASHMODE_DIO=y
CONFIG_ESPTOOLPY_FLASHMODE="dio"
CONFIG_FREERTOS_UNICORE=y
```

## sdkconfig.defaults
```kconfig
# Rust often needs a bit of an extra main task stack size compared to C (the default is 3K)
CONFIG_ESP_MAIN_TASK_STACK_SIZE=45768
CONFIG_ESP_MAIN_TASK_AFFINITY_CPU1=y
# Use this to set FreeRTOS kernel tick frequency to 1000 Hz (100 Hz by default).
# This allows to use 1 ms granuality for thread sleeps (10 ms by default).
CONFIG_FREERTOS_HZ=1000

CONFIG_ESP32S2_DEFAULT_CPU_FREQ_240=y
CONFIG_ESP32S3_DEFAULT_CPU_FREQ_240=y
CONFIG_ESP_SYSTEM_EVENT_TASK_STACK_SIZE=4096

CONFIG_ESP32_DEFAULT_CPU_FREQ_240=y
CONFIG_ESPTOOLPY_FLASHFREQ_80M=n
CONFIG_ESPTOOLPY_FLASHMODE_QIO=n

# Workaround for https://github.com/espressif/esp-idf/issues/7631
#CONFIG_MBEDTLS_CERTIFICATE_BUNDLE=n
#CONFIG_MBEDTLS_CERTIFICATE_BUNDLE_DEFAULT_FULL=n

CONFIG_ESP_TLS_SERVER=y
CONFIG_MBEDTLS_SSL_PROTO_DTLS=y

CONFIG_SPIRAM_SUPPORT=y
CONFIG_ESP32_SPIRAM_SUPPORT=y
CONFIG_ESP32S2_SPIRAM_SUPPORT=y
CONFIG_ESP32S3_SPIRAM_SUPPORT=y
CONFIG_SPIRAM_SPEED_80M=y
CONFIG_SPIRAM_IGNORE_NOTFOUND=y
CONFIG_SPIRAM_USE_MALLOC=y

CONFIG_LWIP_ETHARP_TRUST_IP_MAC=n
#CONFIG_LWIP_IRAM_OPTIMIZATION=y

CONFIG_MEMMAP_SMP=y
CONFIG_FREERTOS_UNICORE=n
CONFIG_ESP32_WIFI_IRAM_OPT=y
CONFIG_ESP32_WIFI_RX_IRAM_OPT=y

CONFIG_ESP_INT_WDT=y
CONFIG_ESP_TASK_WDT=n
CONFIG_VFS_SUPPORT_SELECT=y

CONFIG_LWIP_DEBUG=n
CONFIG_CAMERA_TASK_PINNED_TO_CORE=CAMERA_CORE1
CONFIG_ESP32_SPIRAM_SUPPORT=y
CONFIG_ESP32_WIFI_TASK_PINNED_TO_CORE_0=y

CONFIG_MBEDTLS_DEBUG=n
CONFIG_MBEDTLS_DEBUG_LEVEL_WARN=n
```

## templates/project/sdkconfig.defaults
```kconfig
# FreeRTOS/ESPIDF configuration
CONFIG_FREERTOS_HZ=100
CONFIG_ESP_DEFAULT_CPU_FREQ_MHZ_240=y
CONFIG_ESP_DEFAULT_CPU_FREQ_MHZ=240
CONFIG_ESP_SYSTEM_EVENT_TASK_STACK_SIZE=4096
CONFIG_ESPTOOLPY_FLASHFREQ_40M=y
CONFIG_ESPTOOLPY_FLASHMODE_DIO=y
CONFIG_FREERTOS_UNICORE=n
CONFIG_ESP_INT_WDT=y
CONFIG_ESP_TASK_WDT_INIT=n
CONFIG_VFS_SUPPORT_SELECT=y
CONFIG_PTHREAD_TASK_STACK_SIZE_DEFAULT=8192
CONFIG_PTHREAD_TASK_PRIO_DEFAULT=1


# SPIRAM configuration
CONFIG_SPIRAM=y
CONFIG_SPIRAM_SPEED_80M=y
CONFIG_SPIRAM_IGNORE_NOTFOUND=y
CONFIG_SPIRAM_USE_MALLOC=y
CONFIG_SPIRAM_MALLOC_ALWAYSINTERNAL=4090
CONFIG_SPIRAM_ALLOW_BSS_SEG_EXTERNAL_MEMORY=y

# Network Stack config
CONFIG_LWIP_MAX_SOCKETS=13
#CONFIG_SPIRAM_TRY_ALLOCATE_WIFI_LWIP=y
CONFIG_LWIP_DEBUG=n
#CONFIG_LWIP_IRAM_OPTIMIZATION=y


# Main Task (micro-rdk task) configuration
CONFIG_ESP_MAIN_TASK_STACK_SIZE=22528
CONFIG_ESP_MAIN_TASK_AFFINITY_NO_AFFINITY=y
#CONFIG_ESP_MAIN_TASK_AFFINITY_CPU0
#CONFIG_ESP_MAIN_TASK_AFFINITY=0x0


# MbedTLS Config
CONFIG_MBEDTLS_CERTIFICATE_BUNDLE=y
CONFIG_MBEDTLS_CERTIFICATE_BUNDLE_DEFAULT_CMN=y
#CONFIG_MBEDTLS_DEBUG=y
CONFIG_MBEDTLS_SSL_PROTO_DTLS=y
CONFIG_MBEDTLS_DEFAULT_MEM_ALLOC=y
CONFIG_MBEDTLS_TLS_SERVER_AND_CLIENT=y
CONFIG_MBEDTLS_HARDWARE_AES=y
CONFIG_MBEDTLS_HARDWARE_SHA=y

# Wifi Configuration
CONFIG_ESP_WIFI_IRAM_OPT=n
CONFIG_ESP_WIFI_RX_IRAM_OPT=
CONFIG_ESP_WIFI_TASK_PINNED_TO_CORE_0=y

# Coredump
CONFIG_ESP_COREDUMP_ENABLE_TO_FLASH=y
CONFIG_ESP_COREDUMP_DATA_FORMAT_ELF=y
CONFIG_ESP_COREDUMP_CHECKSUM_SHA256=y
CONFIG_ESP_COREDUMP_ENABLE=y
CONFIG_ESP_COREDUMP_MAX_TASKS_NUM=64
CONFIG_ESP_COREDUMP_DECODE="disable"

# NTP Config
CONFIG_LWIP_SNTP_UPDATE_DELAY=86400000
```

## templates/project/sdkconfig.defaults.esp32
```kconfig
CONFIG_ETH_USE_OPENETH=y
CONFIG_MBEDTLS_HARDWARE_AES=y
CONFIG_MBEDTLS_HARDWARE_SHA=y
```
